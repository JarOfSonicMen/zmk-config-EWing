## boards/shields/EWing/Kconfig.defconfig
```kconfig
if SHIELD_EWING_LEFT

config ZMK_KEYBOARD_NAME
    default "EWing"

config ZMK_SPLIT_ROLE_CENTRAL
    default y

endif

if SHIELD_EWING_LEFT || SHIELD_EWING_RIGHT

config ZMK_SPLIT
    default y

endif
```

## boards/shields/EWing/Kconfig.shield
```kconfig
config SHIELD_EWING_LEFT
    def_bool $(shields_list_contains,ewing_left)

config SHIELD_EWING_RIGHT
    def_bool $(shields_list_contains,ewing_right)
```
